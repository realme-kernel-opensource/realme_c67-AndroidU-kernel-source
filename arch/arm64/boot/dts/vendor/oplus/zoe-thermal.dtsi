
&thermal_zones {

	charge-therm {
		polling-delay-passive = <0>;
		polling-delay = <0>;
		thermal-sensors = <&pm6125_adc_tm_iio 2>;
		trips {
			active-config0 {
				temperature = <125000>;
				hysteresis = <1000>;
				type = "passive";
			};
		};
	};
};
