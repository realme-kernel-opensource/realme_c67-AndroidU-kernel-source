## drivers/misc/oplus_tp_panel_notifier/Kconfig
```kconfig
#
# oplus panel notifier driver configuration
#

config OPLUS_TP_PANEL_NOTIFIER
	tristate "oplus touch panel notifier"
	default m
	help
	  Say Y here if you use oplus touch panel notifier.
	  If unsure, say N.
```

## drivers/power/Kconfig
```kconfig
# SPDX-License-Identifier: GPL-2.0-only
source "drivers/power/reset/Kconfig"
source "drivers/power/supply/Kconfig"
source "drivers/power/oplus/Kconfig"

config OPLUS_CHG
	tristate "OPLUS CHARGER KO module"
	default m
	help
	  Enables support for the oplus charging framework

config OPLUS_SM6375R_CHARGER
	bool "OPLUS SM6375R charger driver"
	help
	  Enables support for the oplus charging framework

config DISABLE_OPLUS_FUNCTION
 	bool "DISABLE_OPLUS_FUNCTION for bringup compile"	
	default n
	help
	  Say Y to include support

config OPLUS_SHIP_MODE_SUPPORT
	bool "OPLUS_SHIP_MODE_SUPPORT"
	default n
	help
	  Say Y to include support

config OPLUS_SMART_CHARGER_SUPPORT
	bool "OPLUS smart charger support"
	help
	  Say Y to include support

config OPLUS_CHIP_SOC_NODE
	bool "OPLUS chip soc node"
	help
	  Say Y to include support

config OPLUS_CHG_TEST_KIT
	tristate "Charger Test Kit"
	default n
	help
	  Say Y or M to enable tesk kit
```

## drivers/soc/oplus/Kconfig
```kconfig
source "drivers/soc/oplus/thermal/Kconfig"
source "drivers/soc/oplus/boot/Kconfig"
source "drivers/soc/oplus/device_info/Kconfig"
source "drivers/soc/oplus/dfr/Kconfig"
source "drivers/soc/oplus/mdmrst/Kconfig"
source "drivers/soc/oplus/dft/Kconfig"
source "drivers/soc/oplus/drivers/Kconfig"
source "drivers/soc/oplus/oplus_sensor_feedback/Kconfig"
```

## mm/oplus_mm/Kconfig
```kconfig
# SPDX-License-Identifier: GPL-2.0-only
# Copyright (C) 2018-2020 Oplus. All rights reserved.

config OPLUS_FEATURE_PERFORMANCE_MM
	bool "config oplus kernel mm feature"
	default y
	help
	  define this config to add oplus kernel mm feature









source "mm/oplus_mm/hybridswap_zram/Kconfig"
```
